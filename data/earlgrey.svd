# earlgrey register map
Vendor: lowRISC; File version: 0.1
Single core 3-stage pipeline RISC-V processor ...
CPU: ibex rev01, little endian, no MPU, no FPU, VTOR, 2 interrupt priority bits, 2 interrupts
Registers are 32-bit, read-write, no defined reset value unless marked. A register's access mark holds for its fields unless they carry their own. Offsets are from the block's base; lines under a group give offsets from that group; [hi:lo] are bit positions; {n}, {i} and the like mark numbered series; 'fields as' and 'values as' point back to an identical list; <NAME> marks a mode.

## Memory map
0x40000000 UART0 size 0x1000 — Full duplex serial communication interface, supports bit rates of up to 1 Mbit/s
0x40010000 UART1 size 0x1000 — Full duplex serial communication interface, supports bit rates of up to 1 Mbit/s
0x40020000 UART2 size 0x1000 — Full duplex serial communication interface, supports bit rates of up to 1 Mbit/s
0x40030000 UART3 size 0x1000 — Full duplex serial communication interface, supports bit rates of up to 1 Mbit/s
0x40040000 GPIO size 0x1000 — General-purpose I/O pin control interface for software
0x40050000 SPI_DEVICE size 0x1000 — Serial peripheral interface supporting different device modes, suitable for bulk-load of data into and out of the chip
0x40080000 I2C0 size 0x1000 — I2C interface for host and device mode, supporting up to 1 Mbaud data rates
0x40090000 I2C1 size 0x1000 — I2C interface for host and device mode, supporting up to 1 Mbaud data rates
0x400A0000 I2C2 size 0x1000 — I2C interface for host and device mode, supporting up to 1 Mbaud data rates
0x400E0000 PATTGEN size 0x1000 — Transmission of short time-dependent data patterns on two clock-parallel output channels
0x40100000 RV_TIMER size 0x1000 — Memory-mapped timer unit implementing RISC-V mtime and mtimecmp registers
0x40130000 OTP_CTRL size 0x1000 — Interfaces integrated one-time programmable memory, supports scrambling, integrity and secure wipe
0x40140000 LC_CTRL size 0x1000 — Manages device life cycle states and transitions, and controls key manager, flash, OTP, and debug access
0x40150000 ALERT_HANDLER size 0x1000
0x40300000 SPI_HOST0 size 0x1000 — Serial peripheral interface for host mode, suitable for interfacing external serial NOR flash devices
0x40310000 SPI_HOST1 size 0x1000 — Serial peripheral interface for host mode, suitable for interfacing external serial NOR flash devices
0x40320000 USBDEV size 0x1000 — USB 2.0 Full Speed device interface (12 Mbit/s)
0x40400000 PWRMGR_AON size 0x1000 — Sequences on-chip power, clocks, and resets through different reset and power states
0x40410000 RSTMGR_AON size 0x1000 — Controls the on-chip reset signals, records reset cause and CPU crash dump for software
0x40420000 CLKMGR_AON size 0x1000 — Derives and monitors on-chip clock signals, handles clock gating requests from power manager and software
0x40430000 SYSRST_CTRL_AON size 0x1000 — Manages board-level reset sequencing, interfaces reset and power manager
0x40440000 ADC_CTRL_AON size 0x1000 — Low-power controller for a dual-channel ADC with filtering and debouncing capability
0x40450000 PWM_AON size 0x1000 — Transmission of pulse-width modulated output signals with adjustable duty cycle
0x40460000 PINMUX_AON size 0x1000 — Multiplexes between on-chip hardware blocks and pins; can be configured at runtime
0x40470000 AON_TIMER_AON size 0x1000 — Wakeup and watchdog timers running on a low-power, always-on clock
0x40480000 AST size 0x1000
0x40490000 SENSOR_CTRL_AON size 0x1000
0x40500000 SRAM_CTRL_RET_AON size 0x1000 — Interfacing on-chip SRAM blocks with system bus, supports lightweight scrambling, integrity and secure wipe
0x41000000 FLASH_CTRL size 0x1000 — Interfaces and manages integrated non-volatile flash memory; supports scrambling, integrity, and secure wipe
0x41100000 AES size 0x1000 — AES encryption and decryption engine with SCA and FI countermeasures
0x41110000 HMAC size 0x1000 — Accelerator for SHA-256-based keyed hash message authentication code and the SHA-256 hash function
0x41120000 KMAC size 0x1000 — Accelerator for Keccak-based keyed hash message authentication code and SHA-3 hash functions; with SCA and FI countermeasures
0x41130000 OTBN size 0x1000 — Programmable coprocessor for asymmetric cryptography with SCA and FI countermeasures
0x41140000 KEYMGR size 0x1000 — Managing identities and root keys; shielding confidential assets from software; providing a key derivation interface for software
0x41150000 CSRNG size 0x1000 — Takes entropy bits to produce cryptographically secure random numbers for consumption by hardware blocks and by software
0x41160000 ENTROPY_SRC size 0x1000 — Filters and checks raw entropy bits from a random noise source and forwards them to CSRNG
0x41170000 EDN0 size 0x1000 — Distributes random numbers produced by CSRNG to hardware blocks
0x41180000 EDN1 size 0x1000 — Distributes random numbers produced by CSRNG to hardware blocks
0x411C0000 SRAM_CTRL_MAIN size 0x1000 — Interfacing on-chip SRAM blocks with system bus, supports lightweight scrambling, integrity and secure wipe
0x411E0000 ROM_CTRL size 0x1000 — Interfaces scrambled boot ROM with system bus and KMAC for initial health check after reset
0x411F0000 RV_CORE_IBEX size 0x1000 — Dual-core lockstep 32-bit RISC-V processor running application and control software
0x41200000 RV_DM size 0x1000 — Enables debug support for Ibex, access protected by life cycle
0x48000000 RV_PLIC size 0x1000

## Interrupts
0 AES IRQ (AES)
0 AST IRQ (AST)
0 CLKMGR_AON IRQ (CLKMGR_AON)
0 LC_CTRL IRQ (LC_CTRL)
0 PINMUX_AON IRQ (PINMUX_AON)
0 PWM_AON IRQ (PWM_AON)
0 ROM_CTRL IRQ (ROM_CTRL)
0 RSTMGR_AON IRQ (RSTMGR_AON)
0 RV_CORE_IBEX IRQ (RV_CORE_IBEX)
0 RV_DM IRQ (RV_DM)
0 RV_PLIC IRQ (RV_PLIC)
0 SRAM_CTRL_MAIN IRQ (SRAM_CTRL_MAIN)
0 SRAM_CTRL_RET_AON IRQ (SRAM_CTRL_RET_AON)
1 UART0 IRQ (UART0)
2 UART1 IRQ (UART1)
3 UART2 IRQ (UART2)
4 UART3 IRQ (UART3)
5 GPIO IRQ (GPIO)
6 SPI_DEVICE IRQ (SPI_DEVICE)
7 I2C0 IRQ (I2C0)
8 I2C1 IRQ (I2C1)
9 I2C2 IRQ (I2C2)
10 PATTGEN IRQ (PATTGEN)
11 RV_TIMER IRQ (RV_TIMER)
12 OTP_CTRL IRQ (OTP_CTRL)
13 ALERT_HANDLER IRQ (ALERT_HANDLER)
14 SPI_HOST0 IRQ (SPI_HOST0)
15 SPI_HOST1 IRQ (SPI_HOST1)
16 USBDEV IRQ (USBDEV)
17 PWRMGR_AON IRQ (PWRMGR_AON)
18 SYSRST_CTRL_AON IRQ (SYSRST_CTRL_AON)
19 ADC_CTRL_AON IRQ (ADC_CTRL_AON)
20 AON_TIMER_AON IRQ (AON_TIMER_AON)
21 SENSOR_CTRL_AON IRQ (SENSOR_CTRL_AON)
22 FLASH_CTRL IRQ (FLASH_CTRL)
23 HMAC IRQ (HMAC)
24 KMAC IRQ (KMAC)
25 OTBN IRQ (OTBN)
26 KEYMGR IRQ (KEYMGR)
27 CSRNG IRQ (CSRNG)
28 ENTROPY_SRC IRQ (ENTROPY_SRC)
29 EDN0 IRQ (EDN0)
30 EDN1 IRQ (EDN1)

## Licence text in the file
Copyright lowRISC contributors. Licensed under the Apache License, Version 2.0, see LICENSE for details. SPDX-License-Identifier: Apache-2.0
